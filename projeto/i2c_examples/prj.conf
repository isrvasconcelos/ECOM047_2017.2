## CMakeLists.txt
```
include($ENV{ZEPHYR_BASE}/cmake/app/boilerplate.cmake NO_POLICY_SCOPE)
project(NONE)

include_directories(
    "${PROJECT_BINARY_DIR}/include/generated"
    "${PROJECT_SOURCE_DIR}/include"
    )

# Generate version file
include(build.version.cmake NO_POLICY_SCOPE)

FILE(GLOB app_sources src/*.c)
target_sources(app PRIVATE ${app_sources})

# Schedule a new version file generation after every build
add_custom_command(
    TARGET app
    POST_BUILD
    COMMAND "${CMAKE_COMMAND}"
    -DPROJECT_SOURCE_DIR=${PROJECT_SOURCE_DIR}
    -DPROJECT_BINARY_DIR=${PROJECT_BINARY_DIR}
    -P ${PROJECT_SOURCE_DIR}/build.version.cmake
    )
```

## prj.conf
```kconfig
# nothing here
CONFIG_GPIO=y
CONFIG_MICROBIT_DISPLAY=y
CONFIG_SYS_CLOCK_TICKS_PER_SEC=250
#CONFIG_MICROBIT_DISPLAY_PIN_GRANULARITY=y

CONFIG_I2C=y
CONFIG_I2C_INIT_PRIORITY=60
CONFIG_I2C_0=y
CONFIG_I2C_GPIO=y
CONFIG_I2C_GPIO_0=y
CONFIG_I2C_GPIO_0_SDA_PIN=20
CONFIG_I2C_GPIO_0_SCL_PIN=19

CONFIG_SYS_LOG=y
CONFIG_SYS_LOG_DEFAULT_LEVEL=4
CONFIG_SYS_LOG_SHOW_COLOR=y
```

## src/main.c
```c
/*
 * Copyright (c) 2017 Intel Corporation
 *
 * SPDX-License-Identifier: Apache-2.0
 */

#include "version.h"
#include "i2c_util.h"

struct i2c_dev acc, compass;

#define ACC_DEV_ADDR     0x1D
#define ACC_WHO_AM_I_REG 0x0D
#define ACC_TEST_VALUE   0x5A

#define COMPASS_DEV_ADDR     0x0e
#define COMPASS_WHO_AM_I_REG 0x07
#define COMPASS_TEST_VALUE   0xC4

void main(void)
{
        SYS_LOG_WRN("Firmware version: v%d.%d.%d",
                        VERSION_MAJOR, VERSION_MINOR, VERSION_BUILD);

        i2c_util_dev_init(&acc, ACC_DEV_ADDR, "ACC", ACC_WHO_AM_I_REG,
                                ACC_TEST_VALUE);
        i2c_util_dev_init(&compass, COMPASS_DEV_ADDR, "COMPASS",
                                COMPASS_WHO_AM_I_REG, COMPASS_TEST_VALUE);

        u8_t data[2];

        while(1);

        // while(1) {
        //         i2c_util_read_bytes(&acc, 0x02, data, sizeof(data));
        //         SYS_LOG_DBG("ACC X: %d", (data[1] << 8) | data[0]);
        // }
}
```
